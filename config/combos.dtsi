/* Key positions: 0-9 top row, 10-19 home row, 20-29 bottom row, 30-33 thumbs (L outer, L inner, R inner, R outer) */

#define COMBO_TIMEOUT_MS 50
#define COMBO_PRIOR_IDLE_MS 150
#define NORMAL_LAYERS 0 1

/* require-prior-idle-ms stops combos from firing while typing fast */
#define COMBO(NAME, BINDINGS, KEYPOS) \
  combo_##NAME { \
    bindings = <BINDINGS>; \
    key-positions = <KEYPOS>; \
    layers = <NORMAL_LAYERS>; \
    timeout-ms = <COMBO_TIMEOUT_MS>; \
    require-prior-idle-ms = <COMBO_PRIOR_IDLE_MS>; \
  };

/* Escape and Enter backups on the thumbs */
COMBO(esc, &kp ESC, 30 31)
COMBO(enter, &kp RET, 31 32)

/* Parens: J+K = ( and K+L = ) */
COMBO(lparen, &kp LPAR, 16 17)
COMBO(rparen, &kp RPAR, 17 18)

/* Braces: M+, = { and ,+. = } */
COMBO(lbrace, &kp LBRC, 26 27)
COMBO(rbrace, &kp RBRC, 27 28)

/* JS/TS macros */
COMBO(equal_strict, &equals_strict, 13 14)
COMBO(not_equal, &not_equal, 11 12)
COMBO(and_logical, &and_logical, 21 22)
COMBO(or_logical, &or_logical, 22 23)
COMBO(template_literal, &template_literal, 23 24)
COMBO(arrow, &arrow, 5 6)

/* Game layer toggle: both bottom pinkies (base layer only) */
combo_game {
    bindings = <&tog 4>;
    key-positions = <20 29>;
    layers = <0>;
    timeout-ms = <COMBO_TIMEOUT_MS>;
};

/* System layer, one key only: both top pinkies (base layer only) */
combo_sys {
    bindings = <&sl 5>;
    key-positions = <0 9>;
    layers = <0>;
    timeout-ms = <COMBO_TIMEOUT_MS>;
};
